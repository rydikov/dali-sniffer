## main/Kconfig.projbuild
```kconfig
menu "Sniffer Configuration"

    config WIFI_SSID
        string "Wi-Fi SSID"
        default ""
        help
            Wi-Fi network name for the station connection.

    config WIFI_PASSWORD
        string "Wi-Fi password"
        default ""
        help
            Wi-Fi password for the station connection.

    config MQTT_BROKER_ADDRESS
        string "MQTT broker address"
        default ""
        help
            Broker host or URI. Leave empty to disable MQTT integration.

    config MQTT_CUSTOM_ID
        string "MQTT custom id"
        default "A"
        help
            MQTT root suffix used to form the topic tree dali/<custom_id>.

    config DALI_RX_PIN
        int "DALI RX GPIO Pin"
        default 14
        range 0 39
        help
            GPIO pin number used for receiving DALI bus samples.

    config DALI_TX_PIN
        int "DALI TX GPIO Pin"
        default 17
        range 0 39
        help
            GPIO pin number used for keeping the DALI transceiver output released.

endmenu
```
